## build.tppg2/conf/bblayers.conf
```bitbake
BBPATH = "${TOPDIR}"
BBFILES ?= ""

BBLAYERS  = "${TOPDIR}/meta"
BBLAYERS += " \
  ${TOPDIR}/../meta-openembedded/meta-multimedia \
  ${TOPDIR}/../meta-openembedded/meta-networking \
  ${TOPDIR}/../meta-openembedded/meta-oe \
  ${TOPDIR}/../meta-openembedded/meta-perl \
  ${TOPDIR}/../meta-openembedded/meta-python \
  ${TOPDIR}/../meta-openembedded/meta-webserver \
  ${TOPDIR}/../meta-openembedded/meta-filesystems \
  "

BBLAYERS += "${TOPDIR}/../meta-tibbo"
BBLAYERS += "${TOPDIR}/../meta-sunplus"

# uncomment if need
#BBLAYERS += "${TOPDIR}/../meta-qt5"
#BBLAYERS += "${TOPDIR}/../meta-openamp"

# tensorflow (face recognition)
#BBLAYERS += "${TOPDIR}/../meta-scipy"
#BBLAYERS += "${TOPDIR}/../meta-tensorflow"
# browser test
#BBLAYERS += "${TOPDIR}/../meta-clang"
#BBLAYERS += "${TOPDIR}/../meta-rust"
#BBLAYERS += "${TOPDIR}/../meta-browser"
```

## build.tppg2/conf/bblayers.conf.sample
```bitbake
BBPATH = "${TOPDIR}"
BBFILES ?= ""

BBLAYERS  = "##OEROOT##/meta"
BBLAYERS += " \
  ##OEROOT##/../meta-openembedded/meta-multimedia \
  ##OEROOT##/../meta-openembedded/meta-networking \
  ##OEROOT##/../meta-openembedded/meta-oe \
  ##OEROOT##/../meta-openembedded/meta-perl \
  ##OEROOT##/../meta-openembedded/meta-python \
  ##OEROOT##/../meta-openembedded/meta-webserver \
  ##OEROOT##/../meta-openembedded/meta-filesystems \
  "

BBLAYERS += "##OEROOT##/../meta-tibbo"
BBLAYERS += "##OEROOT##/../meta-sunplus"

BBLAYERS += "##OEROOT##/../meta-qt5"
# uncomment if need
#BBLAYERS += "##OEROOT##/../meta-openamp"

# tensorflow (face recognition)
#BBLAYERS += "${TOPDIR}/../meta-scipy"
#BBLAYERS += "${TOPDIR}/../meta-tensorflow"
# browser test
#BBLAYERS += "${TOPDIR}/../meta-clang"
#BBLAYERS += "${TOPDIR}/../meta-rust"
#BBLAYERS += "${TOPDIR}/../meta-browser"
```

## conf/machine/include/tpp-xserver.inc
```bitbake
PREFERRED_PROVIDER_virtual/xserver ?= "xserver-xorg"

XSERVER ?= "xserver-xorg \
           xf86-input-evdev \
           xf86-input-mouse \
           xf86-video-fbdev \
           xf86-input-keyboard"
```

## conf/machine/include/tppg2-all-prefs.inc
```bitbake
# SRC_URI mirrors is defined at:
# meta-sunplus/recipes-bsp/isp/isp.bb
# meta-sunplus/recipes-bsp/b-chip/bnoos.bb
# meta-sunplus/recipes-bsp/xboot/xboot-src.inc
# meta-sunplus/recipes-bsp/u-boot/u-boot-src.inc

#PREFERRED_PROVIDER_virtual/bootloader = "u-boot-sp"
#PREFERRED_PROVIDER_u-boot = "u-boot-sp"
#PREFERRED_PROVIDER_u-boot-mkimage-native="u-boot-sp-tools-native"
#PREFERRED_PROVIDER_u-boot-mkenvimage-native="u-boot-sp-tools-native"
#PREFERRED_PROVIDER_u-boot-tools = "u-boot-sp-tools"
#PREFERRED_PROVIDER_u-boot-tools-native = "u-boot-sp-tools-native"

uboot_v = "sp"
PREFERRED_VERSION_u-boot-fw-utils = "${uboot_v}"
PREFERRED_VERSION_u-boot-tools = "${uboot_v}"
PREFERRED_VERSION_u-boot-tools-native = "${uboot_v}"
PREFERRED_VERSION_u-boot = "${uboot_v}"



# SRC_URI for "sp" is defined at:
# meta-sunplus/recipes-kernel/linux/linux-sp_%.bbappend

PREFERRED_PROVIDER_virtual/kernel = "linux-sp"
```

## conf/machine/tppg2.inc
```bitbake
require conf/machine/sp7021.conf

require conf/machine/include/tpp-prefs.inc
require conf/machine/include/tpp-xserver.inc
```
